## dts/bindings/input_processors/zmk,input-processor-pinch-zoom.yaml
```yaml
# Copyright (c) 2026
# SPDX-License-Identifier: MIT

description: Input processor that converts pinch wheel events to zoom behavior taps

compatible: "zmk,input-processor-pinch-zoom"

include: ip_zero_param.yaml

properties:
  trigger-code:
    type: int
    required: true
    description: Key event code that marks an active pinch session.
  wheel-code:
    type: int
    required: true
    description: Relative event code carrying pinch direction and magnitude.
  bindings:
    type: phandle-array
    required: true
    description: First binding is zoom-in, second binding is zoom-out.
```

## input_processors/Kconfig
```kconfig
menuconfig ZMK_INPUT_PROCESSOR_DYNAMIC_SCALER
    bool "Dynamic scaler input processor"
    default y
    select SETTINGS
    help
      Enable a dynamic scaler input processor that applies a persisted scale
      factor to REL events (e.g. cursor and scroll).

if ZMK_INPUT_PROCESSOR_DYNAMIC_SCALER

config ZMK_INPUT_PROCESSOR_DYNAMIC_SCALER_DEFAULT_SCALE_X10
    int "Default dynamic scale (x10)"
    range 2 50
    default 10
    help
      Default scale for the dynamic scaler, stored as value * 10.
      10 = 1.0x, 2 = 0.2x, 50 = 5.0x.

config ZMK_INPUT_PROCESSOR_DYNAMIC_SCALER_MIN_SCALE_X10
    int "Minimum dynamic scale (x10)"
    range 2 50
    default 2
    help
      Minimum scale for the dynamic scaler, stored as value * 10.

config ZMK_INPUT_PROCESSOR_DYNAMIC_SCALER_MAX_SCALE_X10
    int "Maximum dynamic scale (x10)"
    range 2 50
    default 50
    help
      Maximum scale for the dynamic scaler, stored as value * 10.

endif

menuconfig ZMK_INPUT_PROCESSOR_BEHAVIORS_CONSUME
    bool "Behaviors consume input processor"
    default y
    help
      Invoke behaviors for matched events, then neutralize the event so it
      does not generate mouse button output. This avoids relying on STOP
      being honored in layer overrides.

menuconfig ZMK_INPUT_PROCESSOR_PINCH_ZOOM
    bool "Pinch zoom input processor"
    default y
    help
      Convert IQS9151 pinch BTN/WHEEL events into zoom-in and zoom-out
      behavior taps.
```
